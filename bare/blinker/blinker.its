## bare/blinker/blinker.its
```
/dts-v1/;

/ {
	description = "Bare Metal LED blinker for RPI 3";
	#address-cells = <1>;

	images {
		kernel@1 {
			description = "Blinker standalone binary";
			type = "kernel";
			data = /incbin/("./blinker.bin");
			os = "u-boot";
			arch = "arm";
			load = <0x8000>;
			entry = <0x8000>;
			compression = "none";
		};
	};

	configurations {
		default = "config@1";

		config@1 {
			description = "Blinker Binary";
			kernel = "kernel@1";
		};
	};
};
```

## linux/linux.its
```
/dts-v1/;

/ {
	description = "Bare Metal LED blinker for RPI 3";
	#address-cells = <1>;

	images {
		kernel@1 {
			description = "Linux Lite";
			type = "kernel";
			data = /incbin/("./kernel/arch/arm/boot/zImage");
			os = "linux";
			arch = "arm";
			compression = "none";
			load = <0x01000000>;
			entry = <0x01000000>;
			hash@1 {
				algo = "crc32";
			};
			hash@2 {
				algo = "sha1";
			};
		};
		ramdisk@1 {
			description = "rpi ramdisk";
			data = /incbin/("./uInitrd");
			type = "ramdisk";
			os = "linux";
			arch = "arm";
			compression = "none";
			load = <0x02100000>;
			hash@1 {
				algo = "crc32";
			};
			hash@2 {
				algo = "sha1";
			};
		};
		fdt@1 {
			description = "rpi FDT";
			data = /incbin/("./kernel/arch/arm/boot/dts/bcm2836-rpi-2-b.dtb");
			type = "flat_dt";
			arch = "arm";
			compression = "none";
			load = <0x00000100>;
			hash@1 {
				algo = "crc32";
			};
			hash@2 {
				algo = "sha1";
			};
		};
	};

	configurations {
		default = "config@1";

		config@1 {
			description = "Lightweight Linux";
			kernel = "kernel@1";
			ramdisk = "ramdisk@1";
			fdt = "fdt@1";
		};
	};
};
```
